## config/boards/shields/moNa3/Kconfig.shield
```kconfig
config SHIELD_MONA3_R
    def_bool $(shields_list_contains,moNa2_R)

config SHIELD_MONA3_L
    def_bool $(shields_list_contains,moNa2_L)
```

## config/west.yml
```yaml
manifest:
  remotes:
    - name: zmkfirmware
      url-base: https://github.com/petejohanson
    - name: sayu-hub
      url-base: https://github.com/sayu-hub
    - name: caksoylar  # <-- new entry
      url-base: https://github.com/caksoylar  
  projects:
    - name: zmk
      remote: zmkfirmware
      revision: feat/pointers-move-scroll
      import: app/west.yml
    - name: zmk-charlieplex
      remote: zmkfirmware
      revision: 7c2ad3db5fcd9c6fead00df8a94b859aa556f71b
      import: app/west.yml
    - name: zmk-pmw3610-driver
      remote: sayu-hub
      revision: main
    - name: zmk-rgbled-widget  # <-- new entry
      remote: caksoylar
      revision: main
  self:
    path: config
```
